#include <IRremote.h>       //红外库

unsigned long lastConnectionTime = 0;
const unsigned long postingInterval = 30000;//每次连接时间
boolean ResponseBegin = false;
String returnValue = "";// 串口接收数据
String a = ""; 
IRsend irsend;//定义红外发射引脚  ，必须接到uno板的3脚  
int kaiGuan , yaoKong;
char string[100];
char seps[]   = ":,";
char *token;

unsigned int butten0[67]={8950,4450,550,550,600,500,600,550,600,500,600,500,650,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1650,600};
unsigned int butten1[67]={8950,4450,550,600,550,550,600,500,600,550,550,550,600,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1650,550};  //待机，
unsigned int butten2[67]={8950,4450,550,550,600,500,600,550,550,550,600,500,600,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1650,550};//音量加，
unsigned int butten3[67]={8950,4450,550,550,600,500,600,550,600,500,600,500,650,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1650,600};//音量减，
unsigned int butten4[67]={8950,4450,600,550,550,550,600,500,600,550,550,550,600,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1650,550};//播放暂停，
unsigned int butten5[67]={8950,4450,550,550,600,500,600,550,550,550,600,500,600,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1700,550};//上一曲，
unsigned int butten6[67]={8900,4500,550,550,550,550,600,550,550,550,550,550,600,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1650,550};//下一曲，

unsigned int* butten[7] = {butten0,butten1,butten2,butten3,butten4,butten5,butten6};

void setup(){
  // put your setup code here,
Serial.begin(9600);
getData();
}
void loop() {
   if(millis() - lastConnectionTime > postingInterval){   //wifi节点关闭后，重新开启节点
     getData();
   }
   if (Serial.available()) {  
      char c = Serial.read();   
      if (c == '{') {
         ResponseBegin = true; 
      }      
      else if (c == '}') {
         ResponseBegin = false;  
      }
      if (ResponseBegin  ){ 
        returnValue += c;  
      }
   }
  
  if (returnValue.length()!=0 && (ResponseBegin == false)){    
      for (int i = 0; i < returnValue.length()+1 ; i++){            //将指令转换格式
        string[i] = returnValue[i];
      } 
    
     token = strtok( string, seps );           //将字符串分段处理
     while( token != NULL ){
        a = token ;
        if(a == "{\"switch\"") {
            a = "";
            token = strtok( NULL, seps );
            a = token;
            kaiGuan = atoi(token);
        } 
        a = "";
        token = strtok( NULL, seps );
        a = token;    
        if (a == "\"controller\""){
            a = "";
            token = strtok( NULL, seps );
            a = token;
            yaoKong = atoi(token);      
            if(kaiGuan ){                //根据指令发送相应的红外码，遥控电器
                irsend.sendRaw(butten[yaoKong],67,38);
            }
        }
        else {
            token = strtok( NULL, seps );      
        }
        a = "";
        memset(string,NULL,100);
        returnValue = ""; 
     }
  }
}
void getData(void) {         //设置wifi板节点，连接服务器
  Serial.println("dofile(\"mqtt.lua\")"); 
  lastConnectionTime = millis();    //记录节点连接时间
}

  
